## conf/machine/dm365-codec-engine-preferred-versions.inc
```bitbake
#EVM DM365 packages preferences

PREFERRED_VERSION_ti-codec-engine = "2_26_02_11"
PREFERRED_VERSION_ti-codec-engine-examples = "2_26_02_11"

#PREFERRED_VERSION_ti-cgt6x = "6_1_14"
PREFERRED_VERSION_ti-framework-components = "2_26_00_01"
PREFERRED_VERSION_ti-linuxutils = "2_26_01_02"
PREFERRED_VERSION_ti-local-power-manager = "1_24_02_09"
PREFERRED_VERSION_ti-lpm-module = "1_24_02_09"
PREFERRED_VERSION_ti-lpm-utils = "1_24_02_09"
PREFERRED_VERSION_ti-xdais = "6_26_01_03"
PREFERRED_VERSION_ti-xdctools = "3_16_03_36"

PREFERRED_VERSION_ti-codecs-dm365 = "4_02_00_00"
PREFERRED_VERSION_ti-codecs-dm365-server = "4_02_00_00"
PREFERRED_VERSION_ti-dm365mm-module = "01_00_03"
PREFERRED_VERSION_ti-dvsdk-demos = "4_02_00_01"

PREFERRED_VERSION_ti-dmai = "2_20_00_15"
PREFERRED_VERSION_ti-dmai-apps = "2_20_00_15"
PREFERRED_VERSION_ti-dmai-tests = "2_20_00_15"

PREFERRED_VERSION_gstreamer-ti = "svnr919"
PREFERRED_VERSION_gstreamer-ti-demo-script = "svnr919"
```

## conf/machine/dm365-evm.conf
```bitbake
#@TYPE: Machine
#@NAME: DM365 CPUs on a TI DM365 EVM board
#@DESCRIPTION: Machine configuration for the TI DM365 EVM board

require ${OEBASE}/arago/conf/machine/include/davinci.inc
require ${OEBASE}/arago/conf/machine/include/dm365.inc

require dm365-codec-engine-preferred-versions.inc

PREFERRED_PROVIDER_virtual/kernel = "linux-davinci"
PREFERRED_PROVIDER_virtual/bootloader = "u-boot-davinci"

PREFERRED_PROVIDER_u-boot = "u-boot-davinci-evm"
UBOOT_MACHINE = "davinci_dm365evm_config"

EXTRA_IMAGEDEPENDS = "u-boot-davinci-evm"
EXTRA_IMAGEDEPENDS += "ubl"
```

## conf/machine/dm814x-evm.conf
```bitbake
#@TYPE: Machine
#@NAME: DM814x-EVM 
#@DESCRIPTION: Machine configuration for the DM814x-EVM

TARGET_ARCH = "arm"
SOC_FAMILY = "ti814x"

require conf/machine/include/tune-cortexa8.inc

PREFERRED_PROVIDER_virtual/kernel = "linux-omap3-evm"
PREFERRED_PROVIDER_virtual/bootloader = "u-boot-omap3-evm"


# Increase this everytime you change something in the kernel
MACHINE_KERNEL_PR = "r1"

KERNEL_IMAGETYPE = "uImage"

UBOOT_ARCH = "arm"
UBOOT_MACHINE = "ti8148_evm_config_nand"
UBOOT_ENTRYPOINT  = "0x80008000"
UBOOT_LOADADDRESS = "0x80008000"


# AM: We don't use this feature because explicitly build u-boot as a package 
#EXTRA_IMAGEDEPENDS += "u-boot-omap3-z3"

# Ship all kernel modules
IMAGE_FSTYPES ?= "jffs2 tar.bz2"

SERIAL_CONSOLE = "115200 ttyO0"
MACHINE_FEATURES = "kernel26 apm usbgadget usbhost vfat ext2 nfs ethernet"
```

## conf/machine/dm814x-z3.conf
```bitbake
#@TYPE: Machine
#@NAME: DM814x Z3 
#@DESCRIPTION: Machine configuration for the DM814x Z3 

TARGET_ARCH = "arm"
SOC_FAMILY = "ti814x"

require conf/machine/include/tune-cortexa8.inc

PREFERRED_PROVIDER_virtual/kernel = "linux-omap3-z3"
PREFERRED_PROVIDER_virtual/bootloader = "u-boot-omap3-z3"


# Increase this everytime you change something in the kernel
MACHINE_KERNEL_PR = "r1"

KERNEL_IMAGETYPE = "uImage"

UBOOT_ARCH = "arm"
UBOOT_MACHINE = "ti8148_evm_config_nand"
UBOOT_ENTRYPOINT  = "0x80008000"
UBOOT_LOADADDRESS = "0x80008000"


# AM: We don't use this feature because explicitly build u-boot as a package 
#EXTRA_IMAGEDEPENDS += "u-boot-omap3-z3"

# Ship all kernel modules
IMAGE_FSTYPES ?= "jffs2 tar.bz2"

SERIAL_CONSOLE = "115200 ttyO0"
MACHINE_FEATURES = "kernel26 apm usbgadget usbhost vfat ext2 nfs ethernet"
```
